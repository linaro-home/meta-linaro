## meta-aarch64/conf/machine/include/arm64/arch-armv8.inc
```bitbake
DEFAULTTUNE ??= "aarch64"

TUNEVALID[aarch64] = "Enable instructions for aarch64"
TUNEVALID[bigendian] = "Enable big-endian mode."
TUNECONFLICTS[aarch64] = ""
MACHINEOVERRIDES .= "${@bb.utils.contains("TUNE_FEATURES", "aarch64", ":aarch64", "" ,d)}"

AVAILTUNES += "aarch64 aarch64eb"

# Little Endian base configs
TUNE_FEATURES_tune-aarch64 = "aarch64"

# Big Endian
TUNE_FEATURES_tune-aarch64eb = "${TUNE_FEATURES_tune-aarch64} bigendian"

ARMPKGARCH = "${@bb.utils.contains("TUNE_FEATURES", "bigendian", "aarch64eb", "aarch64", d)}""
TUNE_ARCH = "${@bb.utils.contains("TUNE_FEATURES", "bigendian", "aarch64eb", "aarch64", d)}"
TUNE_PKGARCH = "${@bb.utils.contains("TUNE_FEATURES", "bigendian", "aarch64eb", "aarch64", d)}"
PACKAGE_EXTRA_ARCHS += "${@bb.utils.contains("TUNE_FEATURES", "bigendian", "aarch64eb", "aarch64", d)}"

# toolchain bits which were in conf/site.conf
# These do not belong here, they belong in the DISTRO config

GCCVERSION       ?= "linaro-4.7"
SDKGCCVERSION    ?= "linaro-4.7"
BINUVERSION      ?= "2.23.51%"
```

## meta-linaro/conf/machine/lng-rt-x86-64.conf
```bitbake
include lng.inc
require conf/machine/include/tune-x86_64.inc
PREFERRED_PROVIDER_virtual/kernel ?= "linaro-lng-rt-x86-64"
```

## meta-linaro/conf/machine/lng-x86-64.conf
```bitbake
include lng.inc
require conf/machine/include/tune-x86_64.inc
PREFERRED_PROVIDER_virtual/kernel ?= "linaro-lng-x86-64"
```

## meta-linaro/conf/machine/lng.inc
```bitbake
KERNEL_IMAGETYPE = "bzImage"

MACHINE_FEATURES += "x86"

MACHINE_ESSENTIAL_EXTRA_RDEPENDS += "v86d"

EXTRA_IMAGE_FEATURES += "autoserial"
PACKAGE_GROUP_autoserial = "auto-serial-console"
```
